## hardware_v1_detection/firmware_esp32c3_node/main/Kconfig.projbuild
```kconfig
menu "Hardware V1.1 C3 IMU node"

config HWV11_C3_I2C_PORT
    int "I2C controller port"
    default 0

config HWV11_C3_I2C_SDA_GPIO
    int "I2C SDA GPIO"
    default 4

config HWV11_C3_I2C_SCL_GPIO
    int "I2C SCL GPIO"
    default 5

config HWV11_C3_I2C_FREQ_HZ
    int "I2C clock frequency"
    default 400000

config HWV11_C3_SAMPLE_RATE_HZ
    int "Sample rate"
    default 100

config HWV11_C3_NODE_ID
    int "Node ID"
    default 1

config HWV11_C3_ESPNOW_CHANNEL
    int "ESP-NOW Wi-Fi channel"
    default 1

endmenu
```

## hardware_v1_detection/firmware_esp32s3/main/Kconfig.projbuild
```kconfig
menu "Hardware V1 gait detection"

config HWV11_HUB_ENABLE_LOCAL_I2C
    bool "Enable local TCA9548A IMU polling on S3 hub"
    default n
    help
        Disable this for V1.1 ESP-NOW bring-up so the S3 only receives remote
        C3 node packets and streams aggregate frames over USB.

config HWV1_I2C_PORT
    int "I2C controller port"
    default 0

config HWV1_I2C_SDA_GPIO
    int "I2C SDA GPIO"
    default 8

config HWV1_I2C_SCL_GPIO
    int "I2C SCL GPIO"
    default 9

config HWV1_I2C_FREQ_HZ
    int "I2C clock frequency"
    default 400000

config HWV1_SAMPLE_RATE_HZ
    int "Sample rate"
    default 200

config HWV1_SERIAL_BAUD
    int "Serial baud rate"
    default 921600

endmenu
```

## hardware_v1_detection/firmware_esp32s3/sdkconfig.defaults
```kconfig
CONFIG_FREERTOS_HZ=1000
CONFIG_LOG_DEFAULT_LEVEL_WARN=y
CONFIG_ESP_CONSOLE_NONE=y
CONFIG_ESP_CONSOLE_SECONDARY_NONE=y
```
